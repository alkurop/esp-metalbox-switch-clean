## components/ble_module/Kconfig.projbuild
```kconfig
menu "Metalbox Device ID"
config DEVICE_ID
        string "device_id"
        default "001"
        help
            Type device id of Metalbox
config MANUFACTURE_NAME
    string "manufacture_name"
    default "Metalbox"
    help
        Name of the manufacture
config DEVICE_NAME
    string "device_name"
    default ""
    help
        Name of the device model
config DEVICE_MODEL_FLAG
    hex "device_model_flag"
    range 0x00 0xFF
    default 0x01  # Set a default value (e.g., 0x42)
    help
        Name of the device model
endmenu
```

## sdkconfig.defaults
```kconfig
CONFIG_BT_ENABLED=y
CONFIG_BTDM_CTRL_MODE_BTDM=y
CONFIG_BTDM_CTRL_HCI_MODE_VHCI=y
CONFIG_BT_BLUEDROID_ENABLED=y
CONFIG_BT_CLASSIC_ENABLED=y
CONFIG_BT_BLE_ENABLED=y
CONFIG_BT_HID_ENABLED=y
CONFIG_BT_HID_DEVICE_ENABLED=y
CONFIG_BT_BLE_42_FEATURES_SUPPORTED=y

# Use lower CPU frequency
# CONFIG_BOOTLOADER_SKIP_VALIDATE_IN_DEEP_SLEEP=y
# Enable tickless idle mode
CONFIG_FREERTOS_USE_TICKLESS_IDLE=y

# Setting option to zero is only recommended if not using sleep modes, or
# if you don't need accurate sleep times.
CONFIG_RTC_CLK_CAL_CYCLES=0

# at risk of not detecting flash corruption, skip bootloader
# verification of the app unless a soft reset or crash happened
#
# note: the larger the application, the bigger the time saved by
# from this option
CONFIG_BOOTLOADER_SKIP_VALIDATE_ON_POWER_ON=y
CONFIG_BOOTLOADER_SKIP_VALIDATE_IN_DEEP_SLEEP=y

# These two settings mean that no logs are printed
# during startup, but it's possible to use esp_log_level_set("*", ESP_LOG_INFO)
# at runtime to get Info-level logging back
CONFIG_LOG_DEFAULT_LEVEL_NONE=y
CONFIG_BOOTLOADER_LOG_LEVEL_NONE=y
CONFIG_DEVICE_ID="005"
```
